## drivers/input/touchscreen/nova_mmi/Kconfig
```kconfig
#
# Novatek NT36xxx touchscreen driver configuration
#
config TOUCHSCREEN_NT36xxx
       tristate "novatek touchscreens"
       depends on I2C
       help
         Say Y here if you have a nvt touchscreen.
	 nvt controllers are multi touch controllers which can
	 report 5 touches at a time.

         If unsure, say N.

         To compile this driver as a module, choose M here: the
         module will be called nvt.
```
